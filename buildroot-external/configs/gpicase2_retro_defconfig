## buildroot-external/package/retroopi-tools/Config.in
```kconfig
config BR2_PACKAGE_RETROOPI_TOOLS
	bool "retroopi-tools"
	select BR2_PACKAGE_LIBDRM
	select BR2_PACKAGE_SDL2
	select BR2_PACKAGE_SDL2_TTF
	select BR2_PACKAGE_SDL2_IMAGE
	help
	  Small on-target helpers for this board:

	  inject-input -- synthesise key presses through /dev/uinput, so the
	  launcher and RetroArch can be driven from a shell over SSH. Injected
	  events travel the same evdev/udev path a real gamepad's do. Requires
	  CONFIG_INPUT_UINPUT.

	  lcdinfo -- status page (game and its cover art, IP, CPU, uptime) on the Pi 4 arcade
	  case's SPI LCD (panel-mipi-dbi); exits at once on boards without one.

	  core-info -- load a libretro core and print its library_name,
	  extensions and every core option with its allowed values, so .opt
	  files can be written from what the core really accepts.
```
